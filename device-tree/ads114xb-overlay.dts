/dts-v1/;
/plugin/;
// Example on raspberrypi 5
/ {
    compatible = "brcm,bcm2835";

    fragment@0 {
        target = <&spi0>;
        __overlay__ {
            status = "okay";

            ads114s06b@0 {
                compatible = "ti,ads114s06b";
                reg = <0>;  // SPI CS 0
                spi-max-frequency = <2000000>;  // Max for ads114s06b is 4.096MHz
                reset-gpios = <&gpio 25 0>; // GPIO25 as reset pin
            };
        };
    };
};
